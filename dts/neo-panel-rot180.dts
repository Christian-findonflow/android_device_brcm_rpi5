/dts-v1/;
/plugin/;

/* NEO dash: the official 7" DSI panel is mounted upside down so the display
 * cable leaves the bottom of the case. Applied after vc4-kms-dsi-7inch, this
 * sets rotation=180 on the panel node that overlay creates; the simple-panel
 * driver reports it on the DRM connector, the composer passes it to
 * SurfaceFlinger, which rotates the output. Touch inversion stays with the
 * stock overlay's invx,invy parameters. */
/ {
	compatible = "brcm,bcm2712";

	fragment@0 {
		target-path = "/panel_disp@1";
		__overlay__ {
			rotation = <180>;
		};
	};
};
